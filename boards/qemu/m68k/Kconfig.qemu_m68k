## boards/qemu/m68k/Kconfig.qemu_m68k
```kconfig
# SPDX-License-Identifier: Apache-2.0

config BOARD_QEMU_M68K
	select QEMU_TARGET
	select SOC_QEMU_VIRT_M68K_M68000 if BOARD_QEMU_M68K_QEMU_VIRT_M68K_M68000
	select SOC_QEMU_VIRT_M68K_M68010 if BOARD_QEMU_M68K_QEMU_VIRT_M68K_M68010
```
